## qemu_x86_64_debug_defconfig
```kconfig
BR2_x86_64=y
BR2_TARGET_GENERIC_GETTY_PORT="tty1"
BR2_SYSTEM_DHCP="eth0"
BR2_LINUX_KERNEL=y
BR2_LINUX_KERNEL_CUSTOM_GIT=y
BR2_LINUX_KERNEL_CUSTOM_REPO_URL="$(KERNEL_DIR)"
BR2_LINUX_KERNEL_CUSTOM_REPO_VERSION="$(KERNEL_VERSION)"
BR2_LINUX_KERNEL_DEFCONFIG="$(ARCH)"
BR2_TARGET_ROOTFS_EXT2=y
BR2_TARGET_ROOTFS_EXT2_4=y
BR2_ROOTFS_OVERLAY="$(ROOTFS_DIR)"
```
